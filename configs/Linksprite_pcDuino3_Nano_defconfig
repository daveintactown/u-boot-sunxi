## configs/Linksprite_pcDuino3_Nano_defconfig
```kconfig
# This is a low-cost Allwinner A20 board with Arduino-style GPIO headers;
# it features 1G RAM, 4G NAND flash, 1 micro-SD, 2 USB sockets, 1 micro
# USB socket for OTG and another for power in, HDMI, SATA, 5V power for
# SATA devices, gigabit Ethernet, an IR receiver, 3.5mm audio out and a
# MIPI camera connector.
#
# For more details, see: http://linux-sunxi.org/LinkSprite_pcDuino3_Nano
CONFIG_SPL=y
CONFIG_SYS_EXTRA_OPTIONS="AXP209_POWER,SUNXI_GMAC,AHCI,SATAPWR=SUNXI_GPH(2),USB_EHCI"
CONFIG_FDTFILE="sun7i-a20-pcduino3-nano.dtb"
CONFIG_USB1_VBUS_PIN="PH11"
+S:CONFIG_ARM=y
+S:CONFIG_ARCH_SUNXI=y
+S:CONFIG_MACH_SUN7I=y
+S:CONFIG_DRAM_CLK=408
+S:CONFIG_DRAM_ZQ=122
+S:CONFIG_DRAM_EMR1=4
```
